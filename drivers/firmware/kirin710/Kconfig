## drivers/firmware/kirin710/Kconfig
```kconfig
# SPDX-License-Identifier: GPL-2.0-only
config KIRIN710_TRUSTCORE
	bool "Huawei Kirin 710 TrustCore client"
	depends on ARM64 && ARCH_HISI && OF_RESERVED_MEM && CMA
	depends on SCSI_UFS_HISI=y && COMMON_CLK_KIRIN710_USB=y
	depends on DMABUF_HEAPS && DMABUF_HEAPS_SYSTEM=y && DMABUF_HEAPS_CMA=y
	select CRYPTO_AES
	select CRYPTO_CBC
	help
	  Enable the TrustCore client used by Huawei Kirin 710 Android
	  vendor services. This includes UFS RPMB, protected memory and
	  legacy ION allocation backed by DMA-BUF heaps.
```

## drivers/net/wireless/hisilicon/hi1102/Kconfig
```kconfig
# SPDX-License-Identifier: GPL-2.0-only
config HI1102_WIFI
	tristate "HiSilicon Hi1102 SDIO Wi-Fi driver (Kirin 710)"
	depends on MMC && CFG80211
	help
	  Wi-Fi driver for HiSilicon Hi1102 SDIO connectivity chipships on
	  Kirin 710 platforms (e.g. Huawei P30 lite) with modern cfg80211
	  WPA3-SAE and 802.11w PMF support.
```

## sound/soc/hisilicon/Kconfig
```kconfig
# SPDX-License-Identifier: GPL-2.0-only
config SND_I2S_HI6210_I2S
	tristate "Hisilicon I2S controller"
	select SND_SOC_GENERIC_DMAENGINE_PCM
	help
	  Hisilicon I2S

config SND_SOC_MARIE
	bool "Huawei P30 Lite (Marie) audio"
	depends on ARCH_HISI && OF && SND_SOC=y && I2C=y
	depends on COMMON_CLK_KIRIN710_USB=y && REGULATOR_KIRIN710_UFS=y
	help
	  Build the Huawei P30 Lite audio driver for the Kirin 710 ASP DMA,
	  HI6555v2 codec and TFA9874 speaker amplifier.
```
